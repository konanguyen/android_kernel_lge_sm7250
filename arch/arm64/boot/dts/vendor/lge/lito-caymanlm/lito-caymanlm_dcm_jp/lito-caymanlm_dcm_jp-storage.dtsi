// SPDX-License-Identifier: GPL-2.0-only
/*
 * Copyright (c) 2018-2019, The Linux Foundation. All rights reserved.
 */

#include "../lito-caymanlm_common/lito-caymanlm_common-storage.dtsi"

&ufsphy_mem {
    compatible = "qcom,ufs-phy-qmp-v4-lito";

    vdda-phy-supply = <&pm8150_l5>;
    vdda-pll-supply = <&pm8150_l9>;
    vdda-phy-max-microamp = <90200>;
    vdda-pll-max-microamp = <19000>;

    status = "ok";
};

&ufshc_mem {
    vdd-hba-supply = <&ufs_phy_gdsc>;
    vdd-hba-fixed-regulator;
    vcc-supply = <&pm8150a_l7>;
    vcc-voltage-level = <2950000 2960000>;
    vccq2-supply = <&pm8150_s4>;
    vcc-max-microamp = <800000>;
    vccq2-max-microamp = <800000>;

    qcom,vddp-ref-clk-supply = <&pm8150_l9>;
    qcom,vddp-ref-clk-max-microamp = <100>;

    status = "ok";
};

&sdhc_1 {
    vdd-supply = <&pm8150a_l7>;
    qcom,vdd-voltage-level = <2950000 2950000>;
    qcom,vdd-current-level = <0 570000>;

    vdd-io-supply = <&pm8150_s4>;
    qcom,vdd-io-always-on;
    qcom,vdd-io-lpm-sup;
    qcom,vdd-io-voltage-level = <1800000 1800000>;
    qcom,vdd-io-current-level = <0 325000>;

    pinctrl-names = "active", "sleep";
    pinctrl-0 = <&sdc1_clk_on &sdc1_cmd_on &sdc1_data_on
                    &sdc1_rclk_on>;
    pinctrl-1 = <&sdc1_clk_off &sdc1_cmd_off &sdc1_data_off
                    &sdc1_rclk_off>;

    status = "ok";
};

&sdhc_2 {
    vdd-supply = <&pm8150a_l9>;
    qcom,vdd-voltage-level = <2950000 2950000>;
    qcom,vdd-current-level = <0 800000>;

    vdd-io-supply = <&pm8150a_l6>;
    qcom,vdd-io-voltage-level = <1800000 2950000>;
    qcom,vdd-io-current-level = <0 22000>;

    pinctrl-names = "active", "sleep";
    pinctrl-0 = <&sdc2_clk_on  &sdc2_cmd_on &sdc2_data_on &sdc2_cd_on>;
    pinctrl-1 = <&sdc2_clk_off &sdc2_cmd_off &sdc2_data_off &sdc2_cd_off>;

    cd-gpios = <&tlmm 69 GPIO_ACTIVE_LOW>;

    status = "ok";
};

