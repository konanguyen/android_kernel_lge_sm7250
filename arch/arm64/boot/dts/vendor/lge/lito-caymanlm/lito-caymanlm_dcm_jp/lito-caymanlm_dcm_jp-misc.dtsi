// SPDX-License-Identifier: GPL-2.0-only
/*
 * Copyright (c) 2018-2019, The Linux Foundation. All rights reserved.
 */

#include "../lito-caymanlm_common/lito-caymanlm_common-misc.dtsi"

&qupv3_se9_i2c {
	/* Override sleep state of pins */
	pinctrl-1 = <&qupv3_se9_i2c_active>;
};
