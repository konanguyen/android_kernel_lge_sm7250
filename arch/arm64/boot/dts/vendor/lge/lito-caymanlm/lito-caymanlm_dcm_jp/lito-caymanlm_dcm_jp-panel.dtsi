// SPDX-License-Identifier: GPL-2.0-only
/*
 * Copyright (c) 2018-2019, The Linux Foundation. All rights reserved.
 */

#include "../lito-caymanlm_common/lito-caymanlm_common-panel.dtsi"


&dsi_sw43103_pv_fhd_dsc_cmd  {
	lge,blmap = <
		0
		5 5 5 5 5 5 5 5 5 5 5 6 6 6 6 7 7 7 7 8
		8 8 9 9 9 9 10 10 10 10 11 11 11 11 12 12 12 13 13 14
		14 14 15 15 16 16 16 17 17 18 18 18 19 19 20 20 20 21 21 22
		22 24 26 28 30 32 34 36 38 40 42 44 46 48 50 52 54 56 58 60
		62 65 67 70 70 73 75 78 80 83 85 88 90 93 95 98 100 103 105 108
		110 113 115 118 120 123 125 128 132 137 141 145 150 154 158 162 167 171 175 180
		184 188 193 197 201 206 210 214 218 223 227 231 236 240 247 253 260 266 273 279
		286 290 296 303 310 316 323 329 336 342 349 355 362 368 375 381 388 394 403 419
		435 451 468 484 500 516 532 548 564 580 597 613 629 645 661 677 693 709 726 742
		758 774 790 795 801 806 811 816 822 827 832 838 843 848 854 859 864 869 875 880
		885 891 896 901 906 912 917 928 940 951 962 974 985 996 1008 1019 1030 1042 1053 1064
		1075 1087 1098 1109 1121 1132 1143 1155 1166 1177 1189 1200 1222 1244 1266 1288 1310 1332 1354 1376
		1398 1420 1442 1463 1485 1507 1529 1551 1573 1595 1617 1639 1661 1683 1705 1708 1710 1713 1715 1718
		1720 1723 1725 1728 1730 1733 1735 1738 1740 1743 1745 1748 1750 1753 1755 1758 1762 1765 1768 1772
		1775 1778 1782 1785 1788 1792 1795 1798 1802 1805 1808 1812 1815 1818 1822 1825 1828 1832 1835 1838
		1842 1845 1848 1852 1855 1858 1862 1865 1868 1872 1875 1878 1882 1885 1888 1892 1895 1898 1902 1905
		1908 1912 1915 1918 1922 1925 1928 1932 1935 1938 1942 1945 1948 1952 1955 1958 1962 1965 1968 1972
		1975 1978 1982 1985 1988 1992 1995 1998 2002 2005 2008 2011 2013 2016 2019 2022 2025 2027 2030 2033
		2036 2039 2041 2044 2047
	>;

	lge,blmap-daylight = <
		0
		5 5 5 5 5 5 5 5 5 5 5 6 6 7 7 7 8 8 8 9
		9 10 10 10 11 11 12 12 12 13 13 13 14 14 15 15 15 16 16 17
		17 17 18 18 19 19 19 20 20 21 21 21 22 22 23 23 23 24 24 25
		25 27 29 31 33 35 38 40 42 44 46 48 50 52 54 56 58 60 63 65
		67 70 73 77 75 78 82 85 88 92 95 98 101 105 108 111 115 118 121 125
		128 131 134 138 141 144 148 151 157 163 169 175 182 188 194 200 206 212 218 224
		231 237 243 249 255 261 267 273 279 286 292 298 304 310 317 324 331 339 346 353
		360 366 373 381 388 395 402 409 416 424 431 438 445 452 459 466 474 481 489 502
		514 527 539 552 564 577 589 602 614 627 640 652 665 677 690 702 715 727 740 752
		765 777 790 803 816 829 842 855 869 882 895 908 921 934 947 960 973 986 999 1012
		1026 1039 1052 1065 1078 1091 1104 1121 1138 1155 1172 1189 1206 1223 1240 1257 1274 1291 1308 1326
		1343 1360 1377 1394 1411 1428 1445 1462 1479 1496 1513 1530 1552 1575 1597 1620 1642 1665 1687 1710
		1732 1755 1777 1800 1822 1845 1867 1890 1912 1935 1957 1980 2002 2025 2047 2047 2047 2047 2047 2047
		2047 2047 2047 2047 2047 2047 2047 2047 2047 2047 2047 2047 2047 2047 2047 2047 2047 2047 2047 2047
		2047 2047 2047 2047 2047 2047 2047 2047 2047 2047 2047 2047 2047 2047 2047 2047 2047 2047 2047 2047
		2047 2047 2047 2047 2047 2047 2047 2047 2047 2047 2047 2047 2047 2047 2047 2047 2047 2047 2047 2047
		2047 2047 2047 2047 2047 2047 2047 2047 2047 2047 2047 2047 2047 2047 2047 2047 2047 2047 2047 2047
		2047 2047 2047 2047 2047 2047 2047 2047 2047 2047 2047 2047 2047 2047 2047 2047 2047 2047 2047 2047
		2047 2047 2047 2047 2047
	>;
};
