/dts-v1/;
/plugin/;

#include <dt-bindings/interrupt-controller/arm-gic.h>
#include "lito-caymanlm_dcm_jp.dtsi"
#include "lito-caymanlm_dcm_jp-pm.dtsi"
#include "../lito-camera/lito-caymanlm-camera_rev-0.1.dtsi"
#include "../lito-caymanlm_common/lito-caymanlm_common-fingerprint_rev0.dtsi"
#include "lito-caymanlm_dcm_jp-usb.dtsi"
#include "lito-caymanlm_dcm_jp-sound.dtsi"

/ {
	model = "LG Electronics, Caymanlm, HW Rev 0.1";
	compatible = "qcom,lito-mtp", "qcom,lito", "qcom,mtp";
	qcom,msm-id = <400 0x10000>;
	qcom,board-id = <0x00040008 0>;
};

&qupv3_se9_i2c {
  status = "disabled";
};
