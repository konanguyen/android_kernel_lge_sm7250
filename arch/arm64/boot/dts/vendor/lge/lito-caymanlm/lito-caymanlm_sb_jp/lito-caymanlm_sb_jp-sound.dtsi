/* SPDX-License-Identifier: GPL-2.0-only */
/*
 * Copyright (c) 2018-2019, The Linux Foundation. All rights reserved.
 */

#include "../lito-caymanlm_common/lito-caymanlm_common-sound.dtsi"
#include "../lito-caymanlm_common/lito-caymanlm_common-sound-tfa9878.dtsi"
#include "../lito-caymanlm_common/lito-caymanlm_common-sound-es9218.dtsi"
#include "../lito-caymanlm_common/lito-caymanlm_common-sound-fmradio.dtsi"
#include "../lito-caymanlm_common/lito-caymanlm_common-sound-vibrator.dtsi"


&lito_snd {
	status = "ok";
	qcom,msm-mi2s-master = <1>, <1>, <1>, <1>, <1>, <1>;
	asoc-codec  = <&stub_codec>, <&bolero>, <&ext_disp_audio_codec>, <&es9218_dac>,
				  <&tfa98xx_spk1>, <&tfa98xx_spk2>;
	asoc-codec-names = "msm-stub-codec.1", "bolero_codec",
			   "msm-ext-disp-audio-codec-rx","es9218-codec.0048",
			   "tfa98xx-codec.0034", "tfa98xx-codec.0035";
	qcom,ext-disp-audio-rx = <1>;
	qcom,audio-routing =
		"AMIC1", "MIC BIAS1",
		"MIC BIAS1", "Analog Mic1",
		"AMIC2", "MIC BIAS2",
		"MIC BIAS2", "Analog Mic2",
		"AMIC3", "MIC BIAS3",
		"MIC BIAS3", "Analog Mic3",
		"AMIC4", "MIC BIAS3",
		"MIC BIAS3", "Analog Mic4",
		"AMIC5", "MIC BIAS4",
		"MIC BIAS4", "Analog Mic5",
		"IN1_HPHL", "HPHL_OUT",
		"IN2_HPHR", "HPHR_OUT",
		"IN3_AUX", "AUX_OUT",
		"TX SWR_ADC0", "ADC1_OUTPUT",
		"TX SWR_ADC1", "ADC2_OUTPUT",
		"TX SWR_ADC2", "ADC3_OUTPUT",
		"TX SWR_ADC3", "ADC4_OUTPUT",
		"RX_TX DEC0_INP", "TX DEC0 MUX",
		"RX_TX DEC1_INP", "TX DEC1 MUX",
		"RX_TX DEC2_INP", "TX DEC2 MUX",
		"RX_TX DEC3_INP", "TX DEC3 MUX",
		"VA_AIF1 CAP", "VA_SWR_CLK",
		"VA_AIF2 CAP", "VA_SWR_CLK",
		"VA_AIF3 CAP", "VA_SWR_CLK",
		"VA SWR_ADC0", "ADC1_OUTPUT",
		"VA SWR_ADC1", "ADC2_OUTPUT",
		"VA SWR_ADC2", "ADC3_OUTPUT",
		"VA SWR_ADC3", "ADC4_OUTPUT";

    lge,fmradio-lna-enable-gpio = <&tlmm 74 0x00>;
    lna-supply = <&pm8150_s4>;
};
