// SPDX-License-Identifier: GPL-2.0-only
/*
 * Copyright (c) 2018-2019, The Linux Foundation. All rights reserved.
 */

#include "../lito-caymanlm_common/lito-caymanlm_common-usb_rev-1.0.dtsi"

&soc {
    vdda_usb_ss_dp_core: vdda_usb_ss_dp_core {
        compatible = "regulator-fixed";
        regulator-name = "vdd_supply";
        regulator-min-microvolt = <880000>;
        regulator-max-microvolt = <880000>;
        enable-active-high;
        gpio = <&pm8150l_gpios 12 GPIO_ACTIVE_HIGH>;
        pinctrl-names = "default";
        pinctrl-0 = <&usb_eldo13>;
    };
};

&usb_qmp_dp_phy {
    vdd-supply = <&vdda_usb_ss_dp_core>;
};

&sde_dp {
    vdda-0p9-supply = <&vdda_usb_ss_dp_core>;
};
