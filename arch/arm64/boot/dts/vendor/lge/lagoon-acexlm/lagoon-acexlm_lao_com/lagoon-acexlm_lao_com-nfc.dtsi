// SPDX-License-Identifier: GPL-2.0-only
/*
 * Copyright (c) 2018-2019, The Linux Foundation. All rights reserved.
 */

#include "../lagoon-acexlm_common/lagoon-acexlm_common-nfc.dtsi"

&qupv3_se0_i2c {
    status = "ok";
    qcom,clk-freq-out = <1000000>;
    #address-cells = <1>;
    #size-cells = <0>;

    nq@28 {
        status = "disabled";
    };

    pn547@28 {
        compatible = "nxp,pn547";
        reg = <0x28>;
        status = "ok";
        nxp,gpio_sda = <&tlmm 0 0x00>;
        nxp,gpio_scl = <&tlmm 1 0x00>;
        nxp,gpio_ven = <&tlmm 2 0x00>;
        nxp,gpio_mode = <&tlmm 8 0x00>;
        nxp,gpio_irq = <&tlmm 9 0x00>;
        nxp,i2c-pull-up = <1>;
        qcom,clk-src = "BBCLK2";
        interrupt-parent = <&tlmm>;
        interrupts = <9 0>;
        interrupt-names = "nfc_irq";
    };
};
