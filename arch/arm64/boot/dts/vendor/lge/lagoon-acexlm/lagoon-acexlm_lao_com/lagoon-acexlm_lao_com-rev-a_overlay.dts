/dts-v1/;
/plugin/;

#include <dt-bindings/interrupt-controller/arm-gic.h>
#include "lagoon-acexlm_lao_com.dtsi"
#include "../lagoon-camera/lagoon-acexlm-camera_hdk.dtsi"

/ {
	model = "LG Electronics, Acexlm, HW Rev A";
	compatible = "qcom,lagoon-mtp", "qcom,lagoon", "qcom,mtp";
	qcom,msm-id = <434 0x10000>;
	qcom,board-id = <0x00060008 0>;
};
