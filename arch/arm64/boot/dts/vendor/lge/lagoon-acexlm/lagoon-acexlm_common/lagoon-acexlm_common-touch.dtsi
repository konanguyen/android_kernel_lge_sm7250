// SPDX-License-Identifier: GPL-2.0-only
/*
 * Copyright (c) 2018-2019, The Linux Foundation. All rights reserved.
 */

&qupv3_se8_i2c {

        status = "ok";

/*
	focaltech@38 {
		compatible = "focaltech_ref,ft8756";
		reg = <0x38>;
		interrupt-parent = <&tlmm>;
		interrupts = <22 0x2008>;
		focaltech,reset-gpio = <&tlmm 21 0x00>;
		focaltech,irq-gpio = <&tlmm 22 0x2008>;
		focaltech,max-touch-number = <5>;
		focaltech,display-coords = <0 0 1080 2340>;

		vdd-supply = <&L6A>;

		pinctrl-names = "pmx_ts_active", "pmx_ts_suspend","pmx_ts_release";
		pinctrl-0 = <&ts_active>;
		pinctrl-1 = <&ts_int_suspend &ts_reset_suspend>;
		pinctrl-2 = <&pmx_ts_release>;

		panel = <&dsi_ft8756_tcl_fhd_video>;
	};
*/

	focaltech@38 {
		status = "disabled";
	};

	focaltech_lge@38 {
		compatible = "focaltech_lge,ft8756_lge";
		status = "ok";
		reg = <0x38>;
		interrupt-parent = <&tlmm>;
		interrupts = <22 0x2008>;
		irqflags = <0x00000002>;

		pinctrl-names = "touch_pin_active", "touch_pin_sleep";
		pinctrl-0 = <&lge_ts_reset_active &lge_ts_int_active>;
		pinctrl-1 = <&lge_ts_reset_suspend &lge_ts_int_suspend>;

		reset-gpio = <&tlmm 21 0x00>;
		irq-gpio = <&tlmm 22 0x2008>;

		/* caps */
		max_x = <1079>;
		max_y = <2399>;
		max_pressure = <0xff>;
		max_width_major = <15>;
		max_width_minor = <15>;
		max_orientation = <1>;
		max_id = <10>;
		hw_reset_delay = <300>;
		sw_reset_delay = <200>;

		/* role */
		use_lpwg = <1>;
		use_lpwg_test = <1>;
		hide_coordinate = <1>;
		use_activepen_status = <0>;
		use_film_status = <0>;
		use_dex_mode = <1>;
		encryption_coordi_enable = <1>;

		/* firmware */
		fw_image = "touch/acexlm/FT8756_Pramboot_V1.2_20190128.img",
				"touch/acexlm/FT8756_FW_LGE_ACE_V0.15_V0x0F_L0x03_20200904_all.img";

		panel_spec = "touch/acexlm/ace_ft8756_limit.txt";
		panel_spec_mfts_folder = "touch/acexlm/ace_ft8756_limit.txt";

		/* asc */
		use_asc = <0>;
		low_delta_thres = <350>;
		high_delta_thres = <600>;
		max_delta_cnt = <2>;

		/* Performance Test */
		use_perf_test = <1>;
		test_delay = <8>;
		test_pressure = <50>;
		test_width = <100>;
		click_test_x = <180>;
		click_test_y = <760>;
		v_drag_test_x = <144>;
		v_drag_test_start_y = <2003>;
		v_drag_test_end_y = <1116>;
		h_drag_test_start_x = <1163>;
		h_drag_test_end_x = <276>;
		h_drag_test_y = <2184>;
	};
};

