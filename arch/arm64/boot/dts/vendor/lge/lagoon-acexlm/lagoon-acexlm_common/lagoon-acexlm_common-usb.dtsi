// SPDX-License-Identifier: GPL-2.0-only
/*
 * Copyright (c) 2018-2019, The Linux Foundation. All rights reserved.
 */

&qusb_phy0 {
       qcom,qusb-phy-tune = <0x46 0x29 0xca 0x04 0x03 0x19>;
       qcom,qusb-phy-tune-host = <0x46 0x29 0xca 0x04 0x03 0x19>;
};

