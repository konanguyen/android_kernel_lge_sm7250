/dts-v1/;
/plugin/;

#include <dt-bindings/interrupt-controller/arm-gic.h>
#include "lito-acelm_lao_com.dtsi"
#include "lito-acelm_lao_com-pm.dtsi"
#include "../lito-camera/lito-acelm-camera_rev-0.1.dtsi"
#include "lito-acelm_lao_com-fingerprint.dtsi"
#include "lito-acelm_lao_com-usb.dtsi"
#include "lito-acelm_lao_com-sound.dtsi"

/ {
	model = "LG Electronics, Acelm, HW Rev 0.1";
	compatible = "qcom,lito-mtp", "qcom,lito", "qcom,mtp";
	qcom,msm-id = <400 0x10000>;
	qcom,board-id = <0x00040008 0>;
};

&qupv3_se9_i2c {
	status = "disabled";
};

&qupv3_se1_i2c {
	status = "disabled";
};

&lge_usb_ds3 {
	lge,use-primary-usb;
};
