/dts-v1/;
/plugin/;

#include <dt-bindings/interrupt-controller/arm-gic.h>
#include "lito-victorialm_lao_com.dtsi"
#include "lito-victorialm_lao_com-pm.dtsi"
#include "../lito-camera/lito-victorialm-camera_rev-a.dtsi"
#include "lito-victorialm_lao_com-fingerprint.dtsi"
#include "lito-victorialm_lao_com-usb.dtsi"
#include "lito-victorialm_lao_com-sound_rev-a.dtsi"

/ {
	model = "LG Electronics, Victorialm, HW Rev A";
	compatible = "qcom,lito-mtp", "qcom,lito", "qcom,mtp";
	qcom,msm-id = <400 0x10000>;
	qcom,board-id = <0x00060008 0>;
};

&qupv3_se9_i2c {
	status = "disabled";
};

&qupv3_se1_i2c {
	status = "disabled";
};
