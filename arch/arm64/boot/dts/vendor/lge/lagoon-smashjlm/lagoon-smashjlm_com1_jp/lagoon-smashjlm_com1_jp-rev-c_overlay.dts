/dts-v1/;
/plugin/;

#include <dt-bindings/interrupt-controller/arm-gic.h>
#include "lagoon-smashjlm_com1_jp.dtsi"
#include "../lagoon-camera/lagoon-smashjlm-camera_hdk.dtsi"

/ {
	model = "LG Electronics, Smashjlm, HW Rev A";
	compatible = "qcom,lagoon-mtp", "qcom,lagoon", "qcom,mtp";
	qcom,msm-id = <434 0x10000>;
	qcom,board-id = <0x00080008 0>;
};
