// SPDX-License-Identifier: GPL-2.0-only
/*
 * Copyright (c) 2018-2019, The Linux Foundation. All rights reserved.
 */

#include "../lagoon-smashjlm_common/lagoon-smashjlm_common-sound.dtsi"
#include "../lagoon-smashjlm_common/lagoon-smashjlm_common-sound-tfa9878.dtsi"
#include "../lagoon-smashjlm_common/lagoon-smashjlm_common-sound-vibrator.dtsi"

