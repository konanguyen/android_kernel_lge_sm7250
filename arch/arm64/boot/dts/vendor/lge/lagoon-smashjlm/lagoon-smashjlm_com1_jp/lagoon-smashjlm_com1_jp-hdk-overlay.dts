/dts-v1/;
/plugin/;

#include <dt-bindings/interrupt-controller/arm-gic.h>
#include "lagoon-smashjlm_com1_jp.dtsi"
#include "../lagoon-camera/lagoon-smashjlm-camera_hdk.dtsi"
#include "lagoon-smashjlm_com1_jp-hdk-haptic.dtsi"

/ {
	model = "LG Electronics, Smashjlm, HDK";
	compatible = "qcom,lagoon-mtp", "qcom,lagoon", "qcom,mtp";
	qcom,msm-id = <434 0x10000>;
	qcom,board-id = <8 0>;
};
