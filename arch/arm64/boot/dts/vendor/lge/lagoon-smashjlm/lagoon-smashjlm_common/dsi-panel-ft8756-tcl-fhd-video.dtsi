&mdss_mdp {
	dsi_ft8756_fhd_video: qcom,mdss_dsi_ft8756_fhd_video {
		qcom,mdss-dsi-panel-name = "ft8756_fhd_video_tcl";
		qcom,mdss-dsi-panel-type = "dsi_video_mode";

		qcom,dsi-ctrl-num = <0>;
		qcom,dsi-phy-num = <0>;

		qcom,mdss-dsi-virtual-channel-id = <0>;
		qcom,mdss-dsi-stream = <0>;
		qcom,mdss-dsi-h-left-border = <0>;
		qcom,mdss-dsi-h-right-border = <0>;
		qcom,mdss-dsi-v-top-border = <0>;
		qcom,mdss-dsi-v-bottom-border = <0>;
		qcom,mdss-dsi-bpp = <24>;
		qcom,mdss-dsi-color-order = "rgb_swap_rgb";
		qcom,mdss-dsi-underflow-color = <0xff>;
		qcom,mdss-dsi-border-color = <0>;
		qcom,mdss-dsi-h-sync-pulse = <0>;
		qcom,mdss-dsi-traffic-mode = "burst_mode";
		qcom,mdss-dsi-lane-map = "lane_map_0123";
		qcom,mdss-dsi-bllp-eof-power-mode;
		qcom,mdss-dsi-bllp-power-mode;
		qcom,mdss-dsi-tx-eot-append;
		qcom,mdss-dsi-lane-0-state;
		qcom,mdss-dsi-lane-1-state;
		qcom,mdss-dsi-lane-2-state;
		qcom,mdss-dsi-lane-3-state;
		qcom,mdss-dsi-dma-trigger = "trigger_sw";
		qcom,mdss-dsi-mdp-trigger = "none";
		qcom,mdss-dsi-reset-sequence = <1 4>, <0 2>, <1 12>;
		qcom,mdss-pan-physical-width-dimension = <69>;
		qcom,mdss-pan-physical-height-dimension = <154>;
		qcom,dsi-select-clocks = "mux_byte_clk0", "mux_pixel_clk0";
		qcom,suspend-ulps-enabled;

		lge,man-name = "TXD";
		lge,ddic-name = "ft8756";
		lge,incell-panel;
		lge,default-brightness = <158>;
		lge,blmap = <
			0 31 31 31 31 31 31 31 31 31 31			/* 0 ~ 10 */
			35 35 36 37 37 38 39 39 40 40			/* 11 ~ 20 */
			41 42 42 43 45 46 48 49 51 52			/* 21 ~ 30 */
			54 55 57 58 60 61 64 67 70 73			/* 31 ~ 40 */
			76 79 81 84 87 90 93 96 101 105			/* 41 ~ 50 */
			110 114 119 123 128 132 137 141 145 145			/* 51 ~ 60 */
			145 157 168 174 180 186 192 198 204 210			/* 61 ~ 70 */
			216 222 230 237 245 252 260 267 275 282			/* 71 ~ 80 */
			290 297 305 312 321 331 340 349 359 368			/* 81 ~ 90 */
			377 386 396 405 414 424 433 444 456 467			/* 91 ~ 100 */
			478 490 501 512 524 535 546 560 560 560			/* 101 ~ 110 */
			574 606 618 631 643 655 668 680 692 705			/* 111 ~ 120 */
			717 731 745 759 773 787 801 815 829 843			/* 121 ~ 130 */
			857 871 885 899 915 932 948 964 980 997			/* 131 ~ 140 */
			1013 1029 1045 1062 1078 1094 1113 1132 1151 1170		/* 141 ~ 150 */
			1189 1208 1241 1241 1265 1284 1310 1310 1310 1342		/* 151 ~ 160 */
			1382 1401 1421 1441 1461 1481 1501 1520 1540 1560		/* 161 ~ 170 */
			1580 1604 1628 1651 1675 1699 1723 1746 1770 1794		/* 171 ~ 180 */
			1818 1841 1865 1890 1916 1941 1966 1992 2017 2042		/* 181 ~ 190 */
			2068 2093 2118 2144 2169 2198 2228 2257 2286 2316		/* 191 ~ 200 */
			2345 2375 2404 2433 2463 2480 2480 2480 2530 2600		/* 201 ~ 210 */
			2627 2654 2681 2707 2734 2761 2788 2815 2842 2869		/* 211 ~ 220 */
			2902 2934 2967 2999 3032 3065 3097 3130 3162 3195		/* 221 ~ 230 */
			3227 3260 3296 3332 3368 3403 3439 3475 3511 3547		/* 231 ~ 240 */
			3583 3618 3654 3690 3727 3764 3800 3837 3874 3911		/* 241 ~ 250 */
			3948 3985 4051 4095 4095 /* 251 ~ 255 */
		>;

		lge,use-color-manager;
		lge,use-color-manager-oled;
		lge,color-manager-default-status = <1>;
		lge,mdss-dsi-color-manager-mode-table = <0 1>;
		//lge,digital-gamma-absent;

		lge,mdss-dsi-hdr-set = [
			39 01 00 00 00 00 02 91 00		//CE disable
			39 01 00 00 00 00 02 94 00		//preset disable
		];
		lge,mdss-dsi-hdr-set-state = "dsi_lp_mode";

		lge,mdss-dsi-saturation-command = [
			39 01 00 00 00 00 02 91 80
			39 01 00 00 00 00 02 00 00
			39 01 00 00 00 00 04 FF 87 56 01
			39 01 00 00 00 00 02 00 80
			39 01 00 00 00 00 03 FF 87 56
			39 01 00 00 00 00 02 00 A0
			39 01 00 00 00 00 0D D6 7F 7F 7F 7F 7F 7F 7F 7F 7F 7F 7F 7F
			39 01 00 00 00 00 02 00 C0
			39 01 00 00 00 00 0D D6 7F 7F 7F 7F 7F 7F 7F 7F 7F 7F 7F 7F
			39 01 00 00 00 00 02 00 E0
			39 01 00 00 00 00 0D D6 7F 7F 7F 7F 7F 7F 7F 7F 7F 7F 7F 7F
			39 01 00 00 00 00 02 00 00
			39 01 00 00 00 00 0D D7 7F 7F 7F 7F 7F 7F 7F 7F 7F 7F 7F 7F
		];
		lge,mdss-dsi-saturation-command-state = "dsi_lp_mode";

		lge,mdss-dsi-hue-command = [
			39 01 00 00 00 00 02 91 80
			39 01 00 00 00 00 02 00 00
			39 01 00 00 00 00 04 FF 87 56 01
			39 01 00 00 00 00 02 00 80
			39 01 00 00 00 00 03 FF 87 56
			39 01 00 00 00 00 02 00 B0
			39 01 00 00 00 00 0D D6 7F 7F 7F 7F 7F 7F 7F 7F 7F 7F 7F 7F
			39 01 00 00 00 00 02 00 D0
			39 01 00 00 00 00 0D D6 7F 7F 7F 7F 7F 7F 7F 7F 7F 7F 7F 7F
			39 01 00 00 00 00 02 00 F0
			39 01 00 00 00 00 0D D6 7F 7F 7F 7F 7F 7F 7F 7F 7F 7F 7F 7F
			39 01 00 00 00 00 02 00 10
			39 01 00 00 00 00 0D D7 7F 7F 7F 7F 7F 7F 7F 7F 7F 7F 7F 7F
		];
		lge,mdss-dsi-hue-command-state = "dsi_lp_mode";

		lge,mdss-dsi-sharpness-command = [
			39 01 00 00 00 00 03 90 80 55
		];
		lge,mdss-dsi-sharpness-command-state = "dsi_lp_mode";

		lge,mdss-dsi-preset-command = [
			39 01 00 00 00 00 02 94 80
		];

		lge,mdss-dsi-preset-command-state = "dsi_lp_mode";

		lge,mdss-dsi-cm-natural = [
			39 01 00 00 00 00 02 91 80
			//39 01 00 00 00 00 02 94 80	//preset
			39 01 00 00 00 00 02 00 00
			39 01 00 00 00 00 04 FF 87 56 01
			39 01 00 00 00 00 02 00 80
			39 01 00 00 00 00 03 FF 87 56
			39 01 00 00 00 00 02 00 A0
			39 01 00 00 00 00 0D D6 7F 7F 7F 7F 7F 7F 7F 7F 7F 7F 7F 7F
			39 01 00 00 00 00 02 00 B0
			39 01 00 00 00 00 0D D6 7F 7F 7F 7F 7F 7F 7F 7F 7F 7F 7F 7F
			39 01 00 00 00 00 02 00 C0
			39 01 00 00 00 00 0D D6 7F 7F 7F 7F 7F 7F 7F 7F 7F 7F 7F 7F
			39 01 00 00 00 00 02 00 D0
			39 01 00 00 00 00 0D D6 7F 7F 7F 7F 7F 7F 7F 7F 7F 7F 7F 7F
			39 01 00 00 00 00 02 00 E0
			39 01 00 00 00 00 0D D6 7F 7F 7F 7F 7F 7F 7F 7F 7F 7F 7F 7F
			39 01 00 00 00 00 02 00 F0
			39 01 00 00 00 00 0D D6 7F 7F 7F 7F 7F 7F 7F 7F 7F 7F 7F 7F
			39 01 00 00 00 00 02 00 00
			39 01 00 00 00 00 0D D7 7F 7F 7F 7F 7F 7F 7F 7F 7F 7F 7F 7F
			39 01 00 00 00 00 02 00 10
			39 01 00 00 00 00 0D D7 7F 7F 7F 7F 7F 7F 7F 7F 7F 7F 7F 7F
		];
		lge,mdss-dsi-cm-natural-state = "dsi_lp_mode";

		lge,mdss-dsi-cm-vivid = [
			39 01 00 00 00 00 02 91 80
			39 01 00 00 00 00 02 94 91
			39 01 00 00 00 00 02 00 00
			39 01 00 00 00 00 04 FF 87 56 01
			39 01 00 00 00 00 02 00 80
			39 01 00 00 00 00 03 FF 87 56
			39 01 00 00 00 00 02 00 A0
			39 01 00 00 00 00 0D D6 98 98 98 98 98 98 98 98 98 98 98 98
			39 01 00 00 00 00 02 00 B0
			39 01 00 00 00 00 0D D6 7F 7F 7F 7F 7F 7F 7F 7F 7F 7F 7F 7F
			39 01 00 00 00 00 02 00 C0
			39 01 00 00 00 00 0D D6 98 98 98 98 98 98 98 98 98 98 98 98
			39 01 00 00 00 00 02 00 D0
			39 01 00 00 00 00 0D D6 7F 7F 7F 7F 7F 7F 7F 7F 7F 7F 7F 7F
			39 01 00 00 00 00 02 00 E0
			39 01 00 00 00 00 0D D6 98 98 98 98 98 98 98 98 98 98 98 98
			39 01 00 00 00 00 02 00 F0
			39 01 00 00 00 00 0D D6 7F 7F 7F 7F 7F 7F 7F 7F 7F 7F 7F 7F
			39 01 00 00 00 00 02 00 00
			39 01 00 00 00 00 0D D7 98 98 98 98 98 98 98 98 98 98 98 98
			39 01 00 00 00 00 02 00 10
			39 01 00 00 00 00 0D D7 7F 7F 7F 7F 7F 7F 7F 7F 7F 7F 7F 7F
		];
		lge,mdss-dsi-cm-vivid-state = "dsi_lp_mode";

		/* Video Enahnacement */
		lge,mdss-dsi-ve-on-command = [
			// Contrast enable
			39 01 00 00 00 00 02 92 93
			// Color enhance (vivid)
			39 01 00 00 00 00 02 91 80
			39 01 00 00 00 00 02 00 00
			39 01 00 00 00 00 04 FF 87 56 01
			39 01 00 00 00 00 02 00 80
			39 01 00 00 00 00 03 FF 87 56
			39 01 00 00 00 00 02 00 A0
			39 01 00 00 00 00 0D D6 98 98 98 98 98 98 98 98 98 98 98 98
			39 01 00 00 00 00 02 00 B0
			39 01 00 00 00 00 0D D6 7F 7F 7F 7F 7F 7F 7F 7F 7F 7F 7F 7F
			39 01 00 00 00 00 02 00 C0
			39 01 00 00 00 00 0D D6 98 98 98 98 98 98 98 98 98 98 98 98
			39 01 00 00 00 00 02 00 D0
			39 01 00 00 00 00 0D D6 7F 7F 7F 7F 7F 7F 7F 7F 7F 7F 7F 7F
			39 01 00 00 00 00 02 00 E0
			39 01 00 00 00 00 0D D6 98 98 98 98 98 98 98 98 98 98 98 98
			39 01 00 00 00 00 02 00 F0
			39 01 00 00 00 00 0D D6 7F 7F 7F 7F 7F 7F 7F 7F 7F 7F 7F 7F
			39 01 00 00 00 00 02 00 00
			39 01 00 00 00 00 0D D7 98 98 98 98 98 98 98 98 98 98 98 98
			39 01 00 00 00 00 02 00 10
			39 01 00 00 00 00 0D D7 7F 7F 7F 7F 7F 7F 7F 7F 7F 7F 7F 7F
		];
		lge,mdss-dsi-ve-on-command-state = "dsi_lp_mode";

		lge,mdss-dsi-ve-off-command = [
			// Contrast disable
			39 01 00 00 00 00 02 92 00
			// Color enhance (natural)
			39 01 00 00 00 00 02 91 80
			39 01 00 00 00 00 02 00 00
			39 01 00 00 00 00 04 FF 87 56 01
			39 01 00 00 00 00 02 00 80
			39 01 00 00 00 00 03 FF 87 56
			39 01 00 00 00 00 02 00 A0
			39 01 00 00 00 00 0D D6 7F 7F 7F 7F 7F 7F 7F 7F 7F 7F 7F 7F
			39 01 00 00 00 00 02 00 B0
			39 01 00 00 00 00 0D D6 7F 7F 7F 7F 7F 7F 7F 7F 7F 7F 7F 7F
			39 01 00 00 00 00 02 00 C0
			39 01 00 00 00 00 0D D6 7F 7F 7F 7F 7F 7F 7F 7F 7F 7F 7F 7F
			39 01 00 00 00 00 02 00 D0
			39 01 00 00 00 00 0D D6 7F 7F 7F 7F 7F 7F 7F 7F 7F 7F 7F 7F
			39 01 00 00 00 00 02 00 E0
			39 01 00 00 00 00 0D D6 7F 7F 7F 7F 7F 7F 7F 7F 7F 7F 7F 7F
			39 01 00 00 00 00 02 00 F0
			39 01 00 00 00 00 0D D6 7F 7F 7F 7F 7F 7F 7F 7F 7F 7F 7F 7F
			39 01 00 00 00 00 02 00 00
			39 01 00 00 00 00 0D D7 7F 7F 7F 7F 7F 7F 7F 7F 7F 7F 7F 7F
			39 01 00 00 00 00 02 00 10
			39 01 00 00 00 00 0D D7 7F 7F 7F 7F 7F 7F 7F 7F 7F 7F 7F 7F
		];
		lge,mdss-dsi-ve-off-command-state = "dsi_lp_mode";

		qcom,mdss-dsi-display-timings {
			timing@0 {
				qcom,mdss-dsi-panel-phy-timings = [00 25 0A 0A 27 24 0A 0A 07 02 04 00];
				qcom,mdss-dsi-t-clk-post = <0x0F>;
				qcom,mdss-dsi-t-clk-pre = <0x39>;
				qcom,display-topology = <1 0 1>;
				qcom,default-topology-index = <0>;
				qcom,mdss-dsi-panel-width = <1080>;
				qcom,mdss-dsi-panel-height = <2400>;
				qcom,mdss-dsi-h-front-porch = <100>;
				qcom,mdss-dsi-h-back-porch = <107>;
				qcom,mdss-dsi-h-pulse-width = <6>;
				qcom,mdss-dsi-h-sync-skew = <0>;
				qcom,mdss-dsi-v-back-porch = <32>;
				qcom,mdss-dsi-v-front-porch = <8>;
				qcom,mdss-dsi-v-pulse-width = <4>;
				qcom,mdss-dsi-panel-framerate = <60>;
				qcom,mdss-dsi-on-command = [
					39 01 00 00 00 00 02 00 00
					39 01 00 00 00 00 04 FF 87 56 01
					39 01 00 00 00 00 02 00 80
					39 01 00 00 00 00 03 FF 87 56
					39 01 00 00 00 00 02 00 A1
					39 01 00 00 00 00 07 B3 04 38 09 60 00 FC
					39 01 00 00 00 00 02 00 80
					39 01 00 00 00 00 07 C0 00 8D 00 08 00 24
					39 01 00 00 00 00 02 00 90
					39 01 00 00 00 00 07 C0 00 8D 00 08 00 24
					39 01 00 00 00 00 02 00 A0
					39 01 00 00 00 00 07 C0 01 18 00 08 00 24
					39 01 00 00 00 00 02 00 B0
					39 01 00 00 00 00 06 C0 00 8D 00 08 24
					39 01 00 00 00 00 02 00 C1
					39 01 00 00 00 00 09 C0 00 D0 00 9F 00 8B 00 EE
					39 01 00 00 00 00 02 00 D7
					39 01 00 00 00 00 07 C0 00 8B 00 08 00 24
					39 01 00 00 00 00 02 00 A3
					39 01 00 00 00 00 07 C1 00 2C 00 2C 00 02
					39 01 00 00 00 00 02 00 80
					39 01 00 00 00 00 11 CE 01 81 09 13 00 D0 00 E8 00 8A 00 9A 00 68 00 74
					39 01 00 00 00 00 02 00 90
					39 01 00 00 00 00 10 CE 00 8E 0C DF 00 8E 80 09 13 00 04 00 21 1F 16
					39 01 00 00 00 00 02 00 A0
					39 01 00 00 00 00 04 CE 00 00 00
					39 01 00 00 00 00 02 00 B0
					39 01 00 00 00 00 04 CE 22 00 00
					39 01 00 00 00 00 02 00 D1
					39 01 00 00 00 00 08 CE 00 00 01 00 00 00 00
					39 01 00 00 00 00 02 00 E1
					39 01 00 00 00 00 0C CE 08 02 4D 02 4D 02 4D 00 00 00 00
					39 01 00 00 00 00 02 00 F1
					39 01 00 00 00 00 0A CE 13 09 0D 00 F6 01 96 00 C2
					39 01 00 00 00 00 02 00 B0
					39 01 00 00 00 00 05 CF 00 00 BF C3
					39 01 00 00 00 00 02 00 B5
					39 01 00 00 00 00 05 CF 04 04 E4 E8
					39 01 00 00 00 00 02 00 C0
					39 01 00 00 00 00 05 CF 09 09 2C 30
					39 01 00 00 00 00 02 00 C5
					39 01 00 00 00 00 05 CF 00 00 08 0C
					39 01 00 00 00 00 02 00 E8
					39 01 00 00 00 00 02 C0 40
					39 01 00 00 00 00 02 00 80
					39 01 00 00 00 00 09 C2 84 00 01 8D 83 00 01 8D
					39 01 00 00 00 00 02 00 A0
					39 01 00 00 00 00 10 C2 82 04 00 02 8C 81 04 00 02 8C 00 04 00 02 8C
					39 01 00 00 00 00 02 00 B0
					39 01 00 00 00 00 10 C2 01 04 00 02 8C 02 04 00 02 8C 03 04 00 02 8C
					39 01 00 00 00 00 02 00 C0
					39 01 00 00 00 00 0B C2 04 04 00 02 8C 05 04 00 02 8C
					39 01 00 00 00 00 02 00 e0
					39 01 00 00 00 00 05 c2 77 77 77 77
					39 01 00 00 00 00 02 00 c0
					39 01 00 00 00 00 05 c3 99 99 99 99
					39 01 00 00 00 00 02 00 80
					39 01 00 00 00 00 11 CB 00 C5 00 00 05 05 00 05 0A 05 C5 00 05 05 00 C0
					39 01 00 00 00 00 02 00 90
					39 01 00 00 00 00 11 CB 00 00 00 00 00 00 00 00 00 00 00 00 00 00 00 00
					39 01 00 00 00 00 02 00 A0
					39 01 00 00 00 00 05 CB 00 00 00 00
					39 01 00 00 00 00 02 00 B0
					39 01 00 00 00 00 05 CB 10 51 94 50
					39 01 00 00 00 00 02 00 C0
					39 01 00 00 00 00 05 CB 10 51 94 50
					39 01 00 00 00 00 02 00 80
					39 01 00 00 00 00 11 CC 00 00 00 00 07 09 0B 0D 25 25 03 00 22 00 24 00
					39 01 00 00 00 00 02 00 90
					39 01 00 00 00 00 09 CC 29 16 17 18 19 1A 1B 26
					39 01 00 00 00 00 02 00 80
					39 01 00 00 00 00 11 CD 00 00 00 00 06 08 0A 0C 25 00 02 00 22 00 24 00
					39 01 00 00 00 00 02 00 90
					39 01 00 00 00 00 09 CD 29 16 17 18 19 1A 1B 26
					39 01 00 00 00 00 02 00 A0
					39 01 00 00 00 00 11 CC 00 00 00 00 08 06 0C 0A 25 25 02 00 24 00 23 00
					39 01 00 00 00 00 02 00 B0
					39 01 00 00 00 00 09 CC 29 16 17 18 19 1A 1B 26
					39 01 00 00 00 00 02 00 A0
					39 01 00 00 00 00 11 CD 00 00 00 00 09 07 0D 0B 25 00 02 00 24 00 23 00
					39 01 00 00 00 00 02 00 B0
					39 01 00 00 00 00 09 CD 29 16 17 18 19 1A 1B 26
					39 01 00 00 00 00 02 00 80
					39 01 00 00 00 00 02 A7 13
					39 01 00 00 00 00 02 00 82
					39 01 00 00 00 00 03 a7 22 02
					39 01 00 00 00 00 02 00 85
					39 01 00 00 00 00 02 C4 1C
					39 01 00 00 00 00 02 00 97
					39 01 00 00 00 00 02 C4 01
					39 01 00 00 00 00 02 00 A0
					39 01 00 00 00 00 04 C4 8D D8 8D
					39 01 00 00 00 00 02 00 93
					39 01 00 00 00 00 02 C5 37
					39 01 00 00 00 00 02 00 97
					39 01 00 00 00 00 02 C5 37
					39 01 00 00 00 00 02 00 B6
					39 01 00 00 00 00 03 C5 23 23
					39 01 00 00 00 00 02 00 9B
					39 01 00 00 00 00 02 F5 4B
					39 01 00 00 00 00 02 00 93
					39 01 00 00 00 00 03 F5 00 00
					39 01 00 00 00 00 02 00 9D
					39 01 00 00 00 00 02 F5 49
					39 01 00 00 00 00 02 00 82
					39 01 00 00 00 00 03 F5 00 00
					39 01 00 00 00 00 02 00 8C
					39 01 00 00 00 00 04 C3 00 00 00
					39 01 00 00 00 00 02 00 84
					39 01 00 00 00 00 03 C5 28 28
					39 01 00 00 00 00 02 00 A4
					39 01 00 00 00 00 02 D7 00
					39 01 00 00 00 00 02 00 80
					39 01 00 00 00 00 03 F5 59 59
					39 01 00 00 00 00 02 00 84
					39 01 00 00 00 00 04 F5 59 59 59
					39 01 00 00 00 00 02 00 96
					39 01 00 00 00 00 02 F5 59
					39 01 00 00 00 00 02 00 A6
					39 01 00 00 00 00 02 F5 59
					39 01 00 00 00 00 02 00 CA
					39 01 00 00 00 00 02 C0 80
					39 01 00 00 00 00 02 00 B1
					39 01 00 00 00 00 02 F5 1f
					39 01 00 00 00 00 02 00 00
					39 01 00 00 00 00 03 D8 27 2F
					39 01 00 00 00 00 02 00 86
					39 01 00 00 00 00 07 C0 01 03 01 01 10 03
					39 01 00 00 00 00 02 00 96
					39 01 00 00 00 00 07 C0 01 03 01 01 10 03
					39 01 00 00 00 00 02 00 A6
					39 01 00 00 00 00 07 C0 01 03 01 01 10 03
					39 01 00 00 00 00 02 00 E9
					39 01 00 00 00 00 07 C0 01 03 01 01 10 03
					39 01 00 00 00 00 02 00 A3
					39 01 00 00 00 00 07 CE 01 03 01 01 10 03
					39 01 00 00 00 00 02 00 B3
					39 01 00 00 00 00 07 CE 01 03 01 01 10 03
					39 01 00 00 00 00 02 00 00
					39 01 00 00 00 00 29 E1 05 06 09 10 7C 1A 21 28 32 70 3A 40 46 4B 25 4F 57 5E 65 99 6B 72 79 81 EF 8B 90 96 9E 6C A6 B1 BE C7 4F D3 E5 F4 FF AB
					39 01 00 00 00 00 02 00 00
					39 01 00 00 00 00 29 E2 05 06 09 10 7C 1A 21 28 32 70 3A 40 46 4B 25 4F 57 5E 65 99 6B 72 79 81 EF 8B 90 96 9E 6C A6 B1 BE C7 4F D3 E5 F4 FF AB
					39 01 00 00 00 00 02 00 00
					39 01 00 00 00 00 29 E3 05 06 09 10 7C 1A 21 28 32 70 3A 40 46 4B 25 4F 57 5E 65 99 6B 72 79 81 EF 8B 90 96 9E 6C A6 B1 BE C7 4F D3 E5 F4 FF AB
					39 01 00 00 00 00 02 00 00
					39 01 00 00 00 00 29 E4 05 06 09 10 7C 1A 21 28 32 70 3A 40 46 4B 25 4F 57 5E 65 99 6B 72 79 81 EF 8B 90 96 9E 6C A6 B1 BE C7 4F D3 E5 F4 FF AB
					39 01 00 00 00 00 02 00 00
					39 01 00 00 00 00 29 E5 05 06 09 10 7C 1A 21 28 32 70 3A 40 46 4B 25 4F 57 5E 65 99 6B 72 79 81 EF 8B 90 96 9E 6C A6 B1 BE C7 4F D3 E5 F4 FF AB
					39 01 00 00 00 00 02 00 00
					39 01 00 00 00 00 29 E6 05 06 09 10 7C 1A 21 28 32 70 3A 40 46 4B 25 4F 57 5E 65 99 6B 72 79 81 EF 8B 90 96 9E 6C A6 B1 BE C7 4F D3 E5 F4 FF AB
					39 01 00 00 00 00 02 00 CC
					39 01 00 00 00 00 02 C0 13
					39 01 00 00 00 00 02 00 82
					39 01 00 00 00 00 02 C5 3A
					39 01 00 00 00 00 02 00 00
					39 01 00 00 00 00 04 FF FF FF FF
					//WA
					39 01 00 00 00 00 02 94 80
					39 01 00 00 00 00 02 00 00
					39 01 00 00 00 00 04 FF 87 56 01
					39 01 00 00 00 00 02 00 80
					39 01 00 00 00 00 03 FF 87 56
					39 01 00 00 00 00 02 00 80
					39 01 00 00 00 00 07 C8 03 E6 04 00 03 B6
					39 01 00 00 00 00 02 00 90
					39 01 00 00 00 00 07 C8 03 AF 04 00 04 00
					39 01 00 00 00 00 02 00 A0
					39 01 00 00 00 00 07 C8 04 00 03 FC 03 80
					//CABC
					39 01 00 00 00 00 02 00 80
					39 01 00 00 00 00 0D CA 80 80 80 80 80 80 80 80 80 80 80 80
					39 01 00 00 00 00 02 00 90
					39 01 00 00 00 00 0A CA FB FF FF FB FF 32 FA FF 66

					39 01 00 00 00 00 03 51 FF 0F
					39 01 00 00 00 00 02 53 2C
					39 01 00 00 00 00 02 55 02 // (55=01 UM (25%) ; 55=02 SM (30%) ; 55=03 MM (35%))

					39 01 00 00 00 00 02 35 00
					05 01 00 00 78 00 02 11 00
					05 01 00 00 14 00 02 29 00
					];
			qcom,mdss-dsi-on-command-state = "dsi_lp_mode";
			qcom,mdss-dsi-off-command =
					[05 01 00 00 14 00 02 28 00
					05 01 00 00 78 00 02 10 00];
			qcom,mdss-dsi-off-command-state = "dsi_lp_mode";
			};
		};
	};
};
