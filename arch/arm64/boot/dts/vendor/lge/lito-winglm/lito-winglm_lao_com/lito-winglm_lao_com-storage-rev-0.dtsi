// SPDX-License-Identifier: GPL-2.0-only
/*
 * Copyright (c) 2018-2019, The Linux Foundation. All rights reserved.
 */

#include "../lito-winglm_common/lito-winglm_common-storage.dtsi"

&sdhc_2 {
    cd-gpios = <&tlmm 69 GPIO_ACTIVE_LOW>;

    status = "ok";
};

