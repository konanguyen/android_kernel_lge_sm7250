/* Copyright (c) 2014, Code Aurora Forum. All rights reserved.
 *
 * This program is free software; you can redistribute it and/or modify
 * it under the terms of the GNU General Public License version 2 and
 * only version 2 as published by the Free Software Foundation.
 *
 * This program is distributed in the hope that it will be useful,
 * but WITHOUT ANY WARRANTY; without even the implied warranty of
 * MERCHANTABILITY or FITNESS FOR A PARTICULAR PURPOSE.  See the
 * GNU General Public License for more details.
 */

&mdss_mdp {
    dsi_sw43103_dv_half_fhd_dsc_cmd: qcom,mdss_dsi_sw43103_dv_half_fhd_dsc_cmd {
		qcom,mdss-dsi-panel-name = "SW43103_2 cmd mode dsc dsi panel";
//		qcom,mdss-dsi-panel-name = "SW43103 half fhd cmd mode dsc dsi panel";
		qcom,mdss-dsi-panel-type = "dsi_cmd_mode";
		qcom,mdss-dsi-virtual-channel-id = <0>;
		qcom,mdss-dsi-stream = <0>;
		qcom,mdss-dsi-t-clk-post = <0x14>;
		qcom,mdss-dsi-t-clk-pre = <0x10>;
		qcom,mdss-dsi-bpp = <24>;
		qcom,mdss-dsi-color-order = "rgb_swap_rgb";
		qcom,mdss-dsi-underflow-color = <0xff>;
		qcom,mdss-dsi-border-color = <0>;
/*		qcom,dsi-ctrl-num = <0>;
		qcom,dsi-phy-num = <0>;
		qcom,dsi-select-clocks = "mux_byte_clk0", "mux_pixel_clk0",
					"src_byte_clk0", "src_pixel_clk0",
					"shadow_byte_clk0", "shadow_pixel_clk0";*/
		qcom,mdss-dsi-traffic-mode = "burst_mode";
		qcom,mdss-dsi-lane-map = "lane_map_0123";
		qcom,mdss-dsi-bllp-eof-power-mode;
		qcom,mdss-dsi-bllp-power-mode;
		qcom,mdss-dsi-lane-0-state;
		qcom,mdss-dsi-lane-1-state;
		qcom,mdss-dsi-lane-2-state;
		qcom,mdss-dsi-lane-3-state;
		qcom,mdss-dsi-reset-sequence = <1 10>, <0 2>, <1 10>;
		qcom,mdss-dsi-dma-trigger = "trigger_sw";
		qcom,mdss-dsi-mdp-trigger = "none";
		qcom,mdss-dsi-te-pin-select = <1>;
		qcom,panel-te-source = <1>;
		qcom,mdss-dsi-wr-mem-start = <0x2c>;
		qcom,mdss-dsi-wr-mem-continue = <0x3c>;
		qcom,mdss-dsi-te-dcs-command = <1>;
//		qcom,mdss-dsi-te-check-enable;
//		qcom,mdss-dsi-te-using-te-pin;
		qcom,mdss-dsi-lp11-init;
		qcom,mdss-dsi-tx-eot-append;
		qcom,dsi-sec-ctrl-num = <1>;
		qcom,dsi-sec-phy-num = <1>;
		/* qcom,dsi-select-sec-clocks = "src_byte_clk1", "src_pixel_clk1"; */
		qcom,dsi-select-sec-clocks = "mux_byte_clk1", "mux_pixel_clk1";
		qcom,ulps-enabled;
		//qcom,null-insertion-enabled;

		qcom,mdss-dsi-panel-hdr-enabled;
		qcom,mdss-dsi-panel-hdr-color-primaries = <14880 15935 32435 16555 14945 30910 7790 3415>;
		qcom,mdss-dsi-panel-peak-brightness = <5000000>;		/* max. 500nits */
		qcom,mdss-dsi-panel-blackness-level = <6134>;

		qcom,mdss-pan-physical-width-dimension = <69>;
		qcom,mdss-pan-physical-height-dimension = <80>;

		//lge,use-dim-ctrl;
		/* Brightness Map List */
		lge,blmap = <
			0
			5 5 5 5 5 5 5 5 5 5 6 6 7 7 8 8 9 9 10 10
			11 11 12 12 13 13 14 14 15 15 16 16 17 17 18 18 20 21 23 24
			26 27 28 29 30 32 33 34 35 36 37 39 40 41 42 43 44 46 47 48
			49 51 54 56 58 60 63 65 67 70 72 74 77 79 81 83 86 88 90 93
			95 98 102 105 104 107 111 114 118 121 125 128 132 135 139 142 146 149 153 156
			160 163 167 170 174 177 181 184 188 193 197 202 206 210 215 219 223 228 232 237
			241 245 250 254 259 263 267 272 276 280 285 289 294 298 304 310 316 322 328 334
			341 345 351 357 363 369 375 381 388 394 400 406 412 418 424 430 436 442 450 457
			464 471 478 485 492 499 506 513 520 527 535 542 549 556 563 570 577 584 591 598
			605 612 619 628 637 646 655 664 673 682 691 700 709 718 727 735 744 753 762 771
			780 789 798 807 816 825 834 844 854 864 874 884 894 903 913 923 933 943 953 963
			973 983 993 1003 1013 1022 1032 1042 1052 1062 1072 1082 1093 1103 1114 1125 1135 1146 1157 1168
			1178 1189 1200 1210 1221 1232 1242 1253 1264 1275 1285 1296 1307 1317 1328 1328 1328 1328 1328 1328
			1328 1328 1328 1328 1328 1328 1328 1328 1328 1328 1328 1328 1328 1328 1328 1328 1328 1328 1328 1328
			1328 1328 1328 1328 1328 1328 1328 1328 1328 1328 1328 1328 1328 1328 1328 1328 1328 1328 1328 1328
			1328 1328 1328 1328 1328 1328 1328 1328 1328 1328 1328 1328 1328 1328 1328 1328 1328 1328 1328 1328
			1328 1328 1328 1328 1328 1328 1328 1328 1328 1328 1328 1328 1328 1328 1328 1328 1328 1328 1328 1328
			1328 1328 1328 1328 1328 1328 1328 1328 1328 1328 1328 1328 1328 1328 1328 1328 1328 1328 1328 1328
			1328 1328 1328 1328 1328
		>;
		lge,blmap-ve = <
			0
			5 5 5 5 5 5 5 5 5 5 6 6 7 7 8 8 9 9 10 10
			11 11 12 12 13 13 14 14 15 15 16 16 17 17 18 18 20 21 23 24
			26 28 29 31 32 34 36 37 39 40 42 44 45 47 48 50 52 53 55 56
			58 61 64 67 70 72 75 78 81 84 87 90 93 95 98 101 104 107 110 113
			116 120 125 130 127 132 136 141 146 151 155 160 165 170 174 179 184 189 193 198
			203 208 212 217 222 227 231 236 241 247 252 258 263 269 274 279 285 290 296 301
			307 312 317 323 328 334 339 344 350 355 361 366 372 377 385 392 400 408 415 423
			430 436 444 451 459 466 474 482 489 497 505 512 520 528 535 543 551 558 568 577
			586 596 605 614 623 632 642 651 660 669 679 688 697 706 715 725 734 743 752 761
			771 780 789 801 812 824 836 847 859 870 882 894 905 917 929 940 952 963 975 987
			998 1010 1022 1033 1045 1056 1068 1079 1090 1102 1113 1124 1135 1146 1158 1169 1180 1191 1202 1214
			1225 1236 1247 1258 1270 1281 1292 1303 1314 1326 1337 1348 1364 1379 1395 1410 1426 1441 1457 1472
			1488 1503 1519 1534 1550 1565 1581 1596 1612 1627 1643 1658 1674 1689 1705 1708 1710 1713 1715 1718
			1720 1723 1725 1728 1730 1733 1735 1738 1740 1743 1745 1748 1750 1753 1755 1758 1762 1765 1768 1772
			1775 1778 1782 1785 1788 1792 1795 1798 1802 1805 1808 1812 1815 1818 1822 1825 1828 1832 1835 1838
			1842 1845 1848 1852 1855 1858 1862 1865 1868 1872 1875 1878 1882 1885 1888 1892 1895 1898 1902 1905
			1908 1912 1915 1918 1922 1925 1928 1932 1935 1938 1942 1945 1948 1952 1955 1958 1962 1965 1968 1972
			1975 1978 1982 1985 1988 1992 1995 1998 2002 2005 2008 2011 2013 2016 2019 2022 2025 2027 2030 2033
			2036 2039 2041 2044 2047
		>;
		lge,blmap-ex = <
			0
			16 16 16 16 16 16 16 16 16 20 24 28 32 37 41 45 49 53 57 61
			65 69 74 78 82 86 90 94 98 102 106 111 115 119 123 127 138 149 161 172
			183 194 205 217 228 239 250 261 273 284 295 306 317 329 340 351 362 374 385 396
			407 418 430 441 452 463 474 486 497 508 519 530 542 553 564 584 604 625 645 665
			685 706 726 746 766 787 807 827 847 867 888 908 928 948 969 989 1009 1026 1042 1059
			1075 1092 1108 1125 1141 1158 1174 1191 1207 1224 1240 1257 1273 1290 1306 1322 1337 1353 1368 1384
			1399 1415 1431 1446 1462 1477 1493 1509 1524 1540 1555 1571 1586 1602 1602 1602 1602 1602 1602 1602
			1625 1649 1672 1696 1719 1743 1766 1789 1813 1836 1860 1883 1906 1930 1953 1977 2000 2024 2047 2047
			2047 2047 2047 2047 2047 2047 2047 2047 2047 2047 2047 2047 2047 2047 2047 2047 2047 2047 2047 2047
			2047 2047 2047 2047 2047 2047 2047 2047 2047 2047 2047 2047 2047 2047 2047 2047 2047 2047 2047 2047
			2047 2047 2047 2047 2047 2047 2047 2047 2047 2047 2047 2047 2047 2047 2047 2047 2047 2047 2047 2047
			2047 2047 2047 2047 2047 2047 2047 2047 2047 2047 2047 2047 2047 2047 2047 2047 2047 2047 2047 2047
			2047 2047 2047 2047 2047 2047 2047 2047 2047 2047 2047 2047 2047 2047 2047
		>;
		lge,blmap-hdr = <
			0
			5 5 5 5 5 5 5 5 5 5 6 6 7 7 8 8 9 9 10 10
			11 11 12 12 13 13 14 14 15 15 16 16 17 17 18 18 20 21 23 24
			26 28 29 31 32 34 36 37 39 40 42 44 45 47 48 50 52 53 55 56
			58 61 64 67 70 72 75 78 81 84 87 90 93 95 98 101 104 107 110 113
			116 120 125 130 127 132 136 141 146 151 155 160 165 170 174 179 184 189 193 198
			203 208 212 217 222 227 231 236 241 247 252 258 263 269 274 279 285 290 296 301
			307 312 317 323 328 334 339 344 350 355 361 366 372 377 385 392 400 408 415 423
			430 436 444 451 459 466 474 482 489 497 505 512 520 528 535 543 551 558 568 577
			586 596 605 614 623 632 642 651 660 669 679 688 697 706 715 725 734 743 752 761
			771 780 789 801 812 824 836 847 859 870 882 894 905 917 929 940 952 963 975 987
			998 1010 1022 1033 1045 1056 1068 1079 1090 1102 1113 1124 1135 1146 1158 1169 1180 1191 1202 1214
			1225 1236 1247 1258 1270 1281 1292 1303 1314 1326 1337 1348 1364 1379 1395 1410 1426 1441 1457 1472
			1488 1503 1519 1534 1550 1565 1581 1596 1612 1627 1643 1658 1674 1689 1705 1708 1710 1713 1715 1718
			1720 1723 1725 1728 1730 1733 1735 1738 1740 1743 1745 1748 1750 1753 1755 1758 1762 1765 1768 1772
			1775 1778 1782 1785 1788 1792 1795 1798 1802 1805 1808 1812 1815 1818 1822 1825 1828 1832 1835 1838
			1842 1845 1848 1852 1855 1858 1862 1865 1868 1872 1875 1878 1882 1885 1888 1892 1895 1898 1902 1905
			1908 1912 1915 1918 1922 1925 1928 1932 1935 1938 1942 1945 1948 1952 1955 1958 1962 1965 1968 1972
			1975 1978 1982 1985 1988 1992 1995 1998 2002 2005 2008 2011 2013 2016 2019 2022 2025 2027 2030 2033
			2036 2039 2041 2044 2047
		>;

		lge,mdss-dsi-nolp-command = [
			05 01 00 00 00 00 01 13
		];
		lge,mdss-dsi-nolp-command-state = "dsi_lp_mode";
		lge,mdss-dsi-lp2-command = [
			05 01 00 00 00 00 01 12
		];
		lge,mdss-dsi-lp2-command-state = "dsi_lp_mode";

		lge,use-color-manager;
		lge,color-manager-default-status = <1>;
		lge,mdss-dsi-color-manager-mode-table = <0 1>, <1 1>, <2 1>, <3 1>;
		lge,digital-gamma-absent;
		/* FP LHBM */
		lge,use-fp-lhbm;
		lge,mdss-dsi-fp-lhbm-command = [
			//FPS ON
			39 01 00 00 00 00 03 55 08 78
		];
		lge,mdss-dsi-fp-lhbm-command-state = "dsi_hs_mode";

		lge,mdss-dsi-fp-lhbm-exit-command = [
			//FPS OFF
			39 01 00 00 00 00 03 55 08 00
		];
		lge,mdss-dsi-fp-lhbm-exit-command-state = "dsi_hs_mode";

		lge,mdss-dsi-fp-lhbm-aod-to-fps = [
			05 01 00 00 00 00 01 13 //Normal On
			39 01 00 00 00 00 03 51 06 A9 //DBV : 6A9h(UI 100%)
			//39 01 00 00 00 00 03 55 08 78 //FPS ON
		];
		lge,mdss-dsi-fp-lhbm-aod-to-fps-state = "dsi_hs_mode";

		lge,mdss-dsi-fp-lhbm-fps-to-aod = [
			//39 01 00 00 00 00 03 55 08 00 //FPS OFF
			39 01 00 00 00 00 03 51 07 FF //DBV : 7FFh(For AOD Band)
			05 01 00 00 00 00 01 12 //AOD On
		];
		lge,mdss-dsi-fp-lhbm-fps-to-aod-state = "dsi_hs_mode";

		/* Screen Color Control */
		lge,mdss-dsi-disp-ctrl-command-1 = [
		    15 01 00 00 00 00 02 B0 A1
			15 01 00 00 00 00 02 53 00
		];
		lge,mdss-dsi-disp-ctrl-command-1-state = "dsi_hs_mode";

		lge,mdss-dsi-wb-default-command = [
			15 01 00 00 00 00 02 B0 A4
			39 01 00 00 00 00 0B B4 00 03 05 AF 03 05 AF 03 05 AF
			39 01 00 00 00 00 1C B5 00 FF 80 00 80 00 80 00 80 00 FF 80 00 80 00 80 00 80 00 FF 80 00 80 00 80 00 80
		];
		lge,mdss-dsi-wb-default-command-state = "dsi_hs_mode";

		lge,digital-gamma-cmds-dummy = [
			15 01 00 00 00 00 02 B0 A4
			39 01 00 00 00 00 0B B4 00 03 05 AF 03 05 AF 03 05 AF
			39 01 00 00 00 00 1C B5 00 FF 80 00 80 00 80 00 80 00 FF 80 00 80 00 80 00 80 00 FF 80 00 80 00 80 00 80
		];
		lge,digital-gamma-cmds-dummy-command = "dsi_hs_mode";

		lge,mdss-dsi-saturation-command = [
		    15 01 00 00 00 00 02 B0 A4
			39 01 00 00 00 00 0D B7 80 80 80 80 80 80 80 80 80 80 80 80
			39 01 00 00 00 00 0D B8 80 80 80 80 80 80 80 80 80 80 80 80
			39 01 00 00 00 00 0D B9 40 40 40 3A 33 3D 40 40 40 40 40 40
			39 01 00 00 00 00 0D BA 80 80 80 80 80 80 80 80 80 80 80 80
		];
		lge,mdss-dsi-saturation-command-state = "dsi_hs_mode";

		lge,mdss-dsi-hue-command = [
		    15 01 00 00 00 00 02 B0 A4
			39 01 00 00 00 00 0D BB 80 80 80 80 80 80 80 80 80 80 80 80
		];
		lge,mdss-dsi-hue-command-state = "dsi_hs_mode";

		lge,mdss-dsi-sharpness-command = [
		    15 01 00 00 00 00 02 B0 A4
			39 01 00 00 00 00 0C B2 89 1F 1F 88 24 68 22 20 04 00 00
		];
		lge,mdss-dsi-sharpness-command-state = "dsi_hs_mode";

		lge,mdss-dsi-cm-cinema = [
			15 01 00 00 00 00 02 B0 A4
			39 01 00 00 00 00 0B B4 00 03 05 AF 03 01 6B 03 01 6B
			39 01 00 00 00 00 1C B5 00 FF 80 00 80 00 80 00 80 00 F2 7E FC 7B F9 78 F6 75 00 C9 79 F2 6B E4 5E D7 50
			39 01 00 00 00 00 0D B7 80 80 80 80 80 80 80 80 80 80 80 80
			39 01 00 00 00 00 0D B8 80 80 80 80 89 80 80 80 80 80 80 80
			39 01 00 00 00 00 0D B9 2F 2D 2D 37 3D 35 3A 3A 3A 3A 35 2E
			39 01 00 00 00 00 0D BA 80 80 80 80 88 80 80 80 80 80 80 7D
			39 01 00 00 00 00 0D BB 5D 5A 7B 8B 75 70 80 80 80 80 83 8C
		];
		lge,mdss-dsi-cm-cinema-state = "dsi_hs_mode";

		lge,mdss-dsi-cm-sports = [
			15 01 00 00 00 00 02 B0 A4
			39 01 00 00 00 00 0B B4 00 03 01 6B 03 01 6B 03 05 AF
			39 01 00 00 00 00 1C B5 00 DD 7B F7 73 EF 6A E6 62 00 F2 7E FC 7B F9 78 F6 75 00 FF 80 00 80 00 80 00 80
		];
		lge,mdss-dsi-cm-sports-state = "dsi_hs_mode";

		lge,mdss-dsi-cm-game = [
			15 01 00 00 00 00 02 B0 A4
			39 01 00 00 00 00 0B B4 00 03 01 6B 03 01 6B 03 05 AF
			39 01 00 00 00 00 1C B5 00 F0 7E FC 7A F8 76 F4 72 00 FB 7F FF 7E FE 7E FD 7D 00 FF 80 00 80 00 80 00 80
		];
		lge,mdss-dsi-cm-game-state = "dsi_hs_mode";

		lge,mdss-dsi-cm-photo = [
			15 01 00 00 00 00 02 B0 A4
			39 01 00 00 00 00 0B B4 00 03 05 AF 03 01 6B 03 01 6B
			39 01 00 00 00 00 1C B5 00 FF 80 00 80 00 80 00 80 00 F2 7E FC 7B F9 78 F6 75 00 C9 79 F2 6B E4 5E D7 50
			39 01 00 00 00 00 0D B7 80 80 80 80 80 80 80 80 80 80 80 80
			39 01 00 00 00 00 0D B8 80 80 7D 78 80 80 80 80 80 80 80 80
			39 01 00 00 00 00 0D B9 25 2A 2D 2D 2F 4D 2D 3B 40 40 40 40
			39 01 00 00 00 00 0D BA 76 6C 6C 6D 6D 80 70 80 80 80 80 80
			39 01 00 00 00 00 0D BB 65 4D 62 78 78 78 80 6D 6D 80 80 80
		];
		lge,mdss-dsi-cm-photo-state = "dsi_hs_mode";

		lge,mdss-dsi-cm-web = [
			15 01 00 00 00 00 02 B0 A4
			39 01 00 00 00 00 0B B4 00 03 05 AF 03 01 6B 03 01 6B
			39 01 00 00 00 00 1C B5 00 FF 80 00 80 00 80 00 80 00 F2 7E FC 7B F9 78 F6 75 00 C9 79 F2 6B E4 5E D7 50
			39 01 00 00 00 00 0D B7 80 80 80 80 80 80 80 80 80 80 80 80
			39 01 00 00 00 00 0D B8 80 80 80 80 80 80 80 80 80 80 80 80
			39 01 00 00 00 00 0D B9 25 29 27 26 27 39 35 2F 2B 2B 20 28
			39 01 00 00 00 00 0D BA 79 70 70 70 75 70 70 70 63 63 63 63
			39 01 00 00 00 00 0D BB 66 70 8A 8A 67 67 80 95 95 80 8B 78
		];
		lge,mdss-dsi-cm-web-state = "dsi_hs_mode";

		/* Video Enahnacement */
		lge,mdss-dsi-ve-on-command = [
		    15 01 00 00 00 00 02 B0 A1
			15 01 00 00 00 00 02 53 14
			39 01 00 00 00 00 02 55 28
			15 01 00 00 00 00 02 B0 A4
			39 01 00 00 00 00 0C B2 89 3F 2F 88 88 88 22 20 04 00 00
			39 01 00 00 00 00 0D B7 80 80 80 80 80 80 80 80 80 80 80 80
			39 01 00 00 00 00 0D B8 80 80 80 80 80 80 80 80 80 80 80 80
			39 01 00 00 00 00 0D B9 46 46 46 46 46 46 46 46 46 46 46 46
			39 01 00 00 00 00 0D BA 80 80 80 80 80 80 80 80 80 80 80 80
			39 01 00 00 00 00 0D BB 80 80 80 80 80 80 80 80 80 80 80 80
		];
		lge,mdss-dsi-ve-on-command-state = "dsi_hs_mode";

		lge,mdss-dsi-ve-off-command = [
		    15 01 00 00 00 00 02 B0 A1
			39 01 00 00 00 00 02 55 08
		];
		lge,mdss-dsi-ve-off-command-state = "dsi_hs_mode";

		lge,use-irc-ctrl;
		lge,mdss-dsi-irc-command = [
			15 01 00 00 00 00 02 B0 A5
			39 01 00 00 00 00 08 B1 60 C0 00 00 00 10 FF
		];
		lge,mdss-dsi-irc-command-state = "dsi_hs_mode";

		lge,use-ace-ctrl;
		lge,default-ace-mode = <0>;
		lge,mdss-dsi-ace-tune-command = [
			15 01 00 00 00 00 02 B0 A4
			39 01 00 00 00 00 0C B2 89 3F 2F 88 88 88 33 20 04 00 00
			39 01 00 00 00 00 07 B3 00 80 FF 88 08 93
			15 01 00 00 00 00 02 B0 A1
			15 01 00 00 00 00 02 53 14
			39 01 00 00 00 00 02 55 28
		];
		lge,mdss-dsi-ace-restore-command = [
			15 01 00 00 00 00 02 B0 A1
			15 01 00 00 00 00 02 53 00
			39 01 00 00 00 00 02 55 08
		];
		lge,mdss-dsi-ace-command-state = "dsi_hs_mode";
		/* tc Perf */
		lge,use-tc-perf;
		lge,mdss-dsi-tc-perf-on-command = [
			15 01 00 00 00 00 02 B0 A3
			39 01 00 00 00 00 1F B6 90 00 A1 90 00 A1 71 B0 F1 63 60 41 45 0D 94 26 BD E4 27 61 40 18 05 9C 08 A9 F8 09 A1 00
		];
		lge,mdss-dsi-tc-perf-on-command-state = "dsi_hs_mode";

		lge,mdss-dsi-tc-perf-off-command = [
			15 01 00 00 00 00 02 B0 A3
			39 01 00 00 00 00 1F B6 90 00 A1 80 F7 AA 71 B0 F1 63 60 41 45 0D 94 26 BD E4 27 61 40 18 05 9C 08 A9 F8 09 A1 00
		];
		lge,mdss-dsi-tc-perf-off-command-state = "dsi_hs_mode";

		qcom,mdss-dsi-display-timings {
			timing@0{
				qcom,partial-update-enabled = "single_roi";
				qcom,panel-roi-alignment = <1080 40 1080 40 1080 40>;
				qcom,mdss-dsi-panel-phy-timings = [00 11 04 04 1E 1E 04 04 02 02 04 00 10 14];
				qcom,mdss-dsi-panel-clockrate = <435355200>;
				qcom,display-topology = <1 1 1>;
				qcom,default-topology-index = <0>;
				qcom,mdss-dsi-panel-framerate = <60>;
				qcom,mdss-dsi-panel-width = <1080>;
				qcom,mdss-dsi-panel-height = <1240>;
				qcom,mdss-dsi-h-front-porch = <50>;
				qcom,mdss-dsi-h-back-porch = <50>;
				qcom,mdss-dsi-h-pulse-width = <30>;
				qcom,mdss-dsi-h-sync-skew = <0>;
				qcom,mdss-dsi-v-back-porch = <2>;
				qcom,mdss-dsi-v-front-porch = <1224>;
				qcom,mdss-dsi-v-pulse-width = <2>;
				qcom,mdss-dsi-h-left-border = <0>;
				qcom,mdss-dsi-h-right-border = <0>;
				qcom,mdss-dsi-v-top-border = <0>;
				qcom,mdss-dsi-v-bottom-border = <0>;
				qcom,mdss-dsi-h-sync-pulse = <0>;
				//qcom,mdss-mdp-transfer-time-us = <15000>;

				qcom,mdss-dsi-on-command = [
					15 01 00 00 00 00 02 B0 A1			//Manufacturer Command Protect
					39 01 00 00 00 00 05 2A 00 00 04 37	//Column Address Set
					39 01 00 00 00 00 05 2B 00 00 09 9B	//Page Address Set
					15 01 00 00 00 00 02 53 04			//CT Off CM Enable
					15 01 00 00 00 00 02 55 08			//HBM Mode2
					39 01 00 00 00 00 05 30 00 00 09 9B	//Partial Address Row Set
					39 01 00 00 00 00 05 31 00 00 04 37	//Partial Address Column Set
					15 01 00 00 00 00 02 35 00			//TE On
					15 01 00 00 00 00 02 B0 CA			//Manufacturer Command Protect
					05 01 00 00 64 00 01 11				//Sleep Out

					15 01 00 00 00 00 02 B0 A6
					39 01 00 00 00 00 05 FC 00 00 41 40		//Touch Vsync_enable

					15 01 00 00 00 00 02 B0 A1			//MCS Lv1
					39 01 00 00 00 00 0D B3 91 49 00 0F 0C 00 0F 0C 28 00 02 14		//Work-Round for AOD VBP Issue

					//FDBV
					15 01 00 00 00 00 02 69 1F

					//FP_Setting(FPS Gamma & FPS Duty)
					39 01 00 00 00 00 0B 55 08 00 82 A8 1C 61 0A 90 04 00

					05 01 00 00 14 00 01 29 //Display On
					];

				qcom,mdss-dsi-post-panel-on-command = [
					//05 01 00 00 78 00 01 12
					//39 01 00 00 00 00 03 51 07 FF
				];

				qcom,mdss-dsi-off-command = [
					05 01 00 00 46 00 01 13
					05 01 00 00 00 00 01 28
					05 01 00 00 46 00 01 10
				];

				qcom,compression-mode = "dsc";
				qcom,mdss-dsc-version = <0x11>;
				qcom,mdss-dsc-scr-version = <0x1>;
				qcom,mdss-dsc-slice-height = <40>;
				qcom,mdss-dsc-slice-width = <540>;
				qcom,mdss-dsc-slice-per-pkt = <2>;
				qcom,mdss-dsc-bit-per-component = <8>;
				qcom,mdss-dsc-bit-per-pixel = <8>;
				qcom,lm-split = <540 540>;
				qcom,mdss-dsc-encoders = <2>;
				qcom,mdss-dsc-block-prediction-enable;

				qcom,mdss-dsi-on-command-state = "dsi_lp_mode";
				qcom,mdss-dsi-off-command-state = "dsi_lp_mode";

				qcom,mode-control-dsi-state = "dsi_lp_mode";
				qcom,mdss-dsi-pps-command-state = "dsi_hs_mode";
			};
		};
	};
};
